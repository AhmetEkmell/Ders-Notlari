LIST p=16F877A
INCLUDE <P16F877A.INC>

__CONFIG _CP_OFF &_WDT_OFF &_HS_OSC &_PWRTE_OFF &_LVP_OFF

SAYAC0 EQU 0x20
SAYAC1 EQU 0x21
SAYAC2 EQU 0x22
TEMP   EQU 0x23

	ORG 0
	GOTO START
	ORG 4
	GOTO START

BANK0 MACRO
	  BCF STATUS,5
	  ENDM
BANK1 MACRO
	  BSF STATUS,5
	  ENDM

START BANK1
	  CLRF TRISC 
	  BANK0
	  CLRF PORTC
	  BSF  PORTC,0

LOOP MOVLW .7
	 MOVWF TEMP

SOLA CALL   BEKLE
	 RLF    PORTC,F
	 DECFSZ TEMP,F
	 GOTO   SOLA

	 MOVLW  .7
	 MOVWF  TEMP
SAGA CALL   BEKLE
	 RRF    PORTC,F
	 DECFSZ TEMP,F
	 GOTO SAGA
     GOTO LOOP

BEKLE  MOVLW .2
	   MOVWF SAYAC0
BEKLE0 MOVLW .50
 	   MOVWF SAYAC1
BEKLE1 MOVLW .50
	   MOVWF SAYAC2
BEKLE2
	   DECFSZ SAYAC2,F
	   GOTO   BEKLE2
	   DECFSZ SAYAC1,F
	   GOTO   BEKLE1
	   DECFSZ SAYAC0,F
	   GOTO   BEKLE0
	   RETURN
	   END
