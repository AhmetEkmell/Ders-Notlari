LIST P=16F877A
INCLUDE <P16F877A.INC>
__CONFIG _CP_OFF &_WDT_OFF &_HS_OSC &_PWRTE_OFF &_LVP_OFF

SAYAC0  EQU 0x20
SAYAC1  EQU 0x21
SAYAC2  EQU 0x22
TEMP    EQU 0x23
BIRLER  EQU 0x24
ONLAR   EQU 0x25
YUZLER  EQU 0x26
BINLER  EQU 0x27
TEMP1   EQU 0x28
TEMP2   EQU 0x29
TEMP3   EQU 0x2A
TEMP4   EQU 0x2B
ISTENEN EQU 0x2C
ESIKDEGERI     EQU 0x2D
;****** RESET VECTOR *****
	ORG 0
	GOTO START
;****** INTERRUPT VECTOR*****
	ORG 4
	GOTO START
;*** MACRO TANIMLAMA *****
BANK0 MACRO
	  BCF STATUS,5 
	  ENDM
BANK1 MACRO
	  BSF STATUS,5
	  ENDM
;**** ALT PROGRAMLAR YAZILABİLİR *****

START BANK1
	  CLRF ADCON1    ; ADC MODUL AYARI YAPILDI
	  MOVLW B'11110000'
	  MOVWF TRISD   ;RD0,....,RD3 ÇIKIŞ OLDU. RD4,...,RD7 INPUT OLDU.
	  CLRF TRISB    ;PORTB LER OUTPUT OLDU.
	  CLRF TRISC    ;PORTC LER OUTPUT OLDU.
	  BANK0
	  MOVLW B'001011001'
	  MOVWF ADCON0 	; ADC MODUL AYARLANDI
	  CLRF PORTC    ; DC MOTOR YON KONTROLÜ RC0  VE CCP1-RC2 PWM SINYALI 
	  CLRF PORTB    ; DISPLAYLER PASSIVE/KAPALI
 	  CLRF PORTD    ; DATA HATTINDA 0 DEĞERİ VAR
	  MOVLW .0
	  MOVWF BINLER
	  MOVLW .0
	  MOVWF YUZLER
	  MOVLW .0
	  MOVWF ONLAR
	  MOVLW .0
	  MOVWF BIRLER
	  MOVLW .128
	  MOVWF ESIKDEGERI   ; JOYSTICK ORTA NOKTA TESİPİTİ İÇİN EŞİK DEĞER 

LOOP CALL ADCOKU  ; RE0/AN5 JOYSTICK ILERI/GERI HAREKETI DIGITALLESTI.
	 CALL YONTESPIT  ;MOTOR YÖN VE HIZ KONTROLÜ YAPILMIŞ OLACAK
	 CALL BASAMAKBUL ; YUZLER BIRLER VE ONLAR REG'LERİ ISTENEN DEN ELDE EDİLMELİ
	 CALL GOSTER     ; 12ms ZAMAN ALIR.
	 GOTO LOOP
;**** ALT PROGRAMLAR YAZILABİLİR ******

ADCOKU  BSF ADCON0,2   ; GO/DONE' = 1 OLDU ANALOG DIGITAL CONVERSION START VERILDI.

ADCOKU1 BTFSC ADCON0,2 ; EĞER GO/DONE' = 0 İSE 1 KOMUT ATLA (ADRESH REGISTERDA 8 BIT VERİ HAZIR)
		GOTO ADCOKU1
		MOVF ADRESH,W
		MOVWF ISTENEN 
		RETURN

BASAMAKBUL         ; ÜÇ BASAMAKLI BULUYOR
		CLRF YUZLER
		CLRF  ONLAR
		CLRF  BIRLER
		MOVF  TEMP2,W  ; YENİ ÖLÇEKLENMİŞ DEGER TEMP2 KULLANILMALI
		MOVWF TEMP

BASAMAKBUL2
	 BCF STATUS,C
	 BCF STATUS,Z
	 MOVLW .100
	 SUBWF TEMP,W 	    ;W=TEMP-W(100)
	 BTFSC STATUS,Z
	 GOTO ESITLIK2  	;Z=1 ESITLIK DURUMU VAR
	 BTFSC STATUS,C 	;Z=0 BUYUKLUK/KUCUKLUK VAR
	 GOTO BUYUKLUK2 	;C=1 ODUNC ALMA YOK BUYUKLUK VAR
	 GOTO BASAMAKBUL1	;****** TEMP İKİ BASAMAKLI HALDE KUCUKLUK BLOGU ******* 
	 
ESITLIK2
	 INCF YUZLER,F
	 RETURN

BUYUKLUK2
	 INCF YUZLER,F ;YUZLER++
 	 MOVLW .100
	 SUBWF TEMP,F ;TEMP=TEMP-100
	 GOTO BASAMAKBUL2

;***************** İKİ BASAMAKLI HALDE İKEN AŞAĞIDAKİ KODLAR ÇALIŞACAK ***********
         ; İKİ basamaklı sayı onlar, birler basamağını buluyor
	 

BASAMAKBUL1
	 BCF STATUS,C
	 BCF STATUS,Z
	 MOVLW .10
	 SUBWF TEMP,W  ;W=TEMP-W(10)
	 BTFSC STATUS,Z
	 GOTO ESITLIK1  ;Z=1 ESITLIK DURUMU VAR
	 BTFSC STATUS,C ;Z=0 BUYUKLUK/KUCUKLUK VAR
	 GOTO BUYUKLUK1 ;C=1 ODUNC ALMA YOK BUYUKLUK VAR
;****** KUCUKLUK BLOGU ******* 
	 MOVF TEMP,W
	 MOVWF BIRLER
	 RETURN

ESITLIK1
	 INCF ONLAR,F 
	 RETURN

BUYUKLUK1
	 INCF ONLAR,F ;ONLAR++
 	 MOVLW .10
	 SUBWF TEMP,F ;TEMP=TEMP-10
	 GOTO BASAMAKBUL1

YONTESPIT ;DC MOTOR İLERİ GERİ VE ORTA DURUMUNU ALGILAMAK VE HIZ KONTROL DEĞERİ AYARLAMAK
	 BCF STATUS,C
	 BCF STATUS,Z
	 MOVF ESIKDEGERI,W
	 SUBWF ISTENEN,W ; W=ISTENEN-W(ESIKDEGERI)
	 BTFSC STATUS,Z
	 GOTO ESITLIK   ;Z=1 ESITLIK DURUMU VAR
	 BTFSC STATUS,C ;Z=0 BUYUKLUK/KUCUKLUK VAR
	 GOTO BUYUKLUK  ;C=1 ODUNC ALMA YOK BUYUKLUK VAR
	 ; GERİ YÖN AKTİF ; KUCUKLUK BLOGU C=0 ODUNC ALMA VAR KUCUKLUK BLOGU
	 
	 BSF PORTC,0   	  ;RC0=1 OLDU GERİ YÖN AKTİF
	 MOVF ISTENEN,W	  ;W=ISTENEN
	 SUBLW .127 	  ;W=127-W(ISTENEN)
	 MOVWF TEMP2	  ;TEMP2 = W
	 BCF STATUS,C
	 RLF TEMP2,F
	 INCF TEMP2,F
	 RETURN

ESITLIK   ; JOYSTICK ORTA KONUMDA
	 CLRF TEMP2
	 RETURN

BUYUKLUK  ; İLERİ YÖN AKTİF
	 BCF PORTC,0      ;RC0=0 OLDU İLERI YON
	 MOVLW .128		  ;W=128
	 SUBWF ISTENEN,W  ;W=ISTENEN-W(128)
	 MOVWF TEMP2
	 BCF STATUS,C
	 RLF TEMP2,F
	 INCF TEMP2,F
	 RETURN
	 
GOSTER 
	MOVLW .15     ;mod10000 de sayma hızı ayarı ; klima uyg. da tuş sekmesini önlemek için kullandık. kullanıcının butondan elini çekme/bırakma süresi.
	MOVWF TEMP1
GOSTER1
	MOVF BINLER,W
	MOVWF PORTD   ;PORTD = W  => DATA BUS = BINLER
	MOVLW B'00000001'
	MOVWF PORTB   ;RB0=1 OLDU BINLER DISPLAY AKTİF
	CALL BEKLE    ;3ms bekler
	MOVF YUZLER,W
	MOVWF PORTD   ;PORTD = W  => DATA BUS = YUZLER
	MOVLW B'00000010'
	MOVWF PORTB   ;RB1=1 OLDU BINLER DISPLAY AKTİF
	CALL BEKLE
	MOVF ONLAR,W
	MOVWF PORTD   ;PORTD = W  => DATA BUS = ONLAR
	MOVLW B'00000100'
	MOVWF PORTB   ;RB2=1 OLDU BINLER DISPLAY AKTİF
	CALL BEKLE
	MOVF BIRLER,W
	MOVWF PORTD   ;PORTD = W  => DATA BUS = BIRLER
	MOVLW B'00001000'
	MOVWF PORTB   ;RB3=1 OLDU BINLER DISPLAY AKTİF
	CALL BEKLE
	DECFSZ TEMP1,F ;TEMP1 = TEMP1-1 EĞER TEMP1=0 İSE 1 ATLA
	GOTO GOSTER1
 	CLRF PORTB    ; DISPLAY MODULU PASSIVE TUM DISPLAYLER KAPALI
	RETURN

BEKLE
	MOVLW .10
	MOVWF SAYAC0
BEKLE0
	MOVLW .50
	MOVWF SAYAC1
BEKLE1
	MOVLW .50
	MOVWF SAYAC2
BEKLE2
	DECFSZ SAYAC2,F
	GOTO BEKLE2
	DECFSZ SAYAC1,F
	GOTO BEKLE1
	DECFSZ SAYAC0,F
	GOTO BEKLE0
	RETURN
	END
	



	
